## conf/distro/include/meta_intel_msdk-security_flags.inc
```bitbake
# Setup extra CFLAGS and LDFLAGS which have 'security' benefits.

SECURITY_CFLAGS_pn-msdk-plugins = ""
```

## conf/layer.conf
```bitbake
# We have a conf and classes directory, add to BBPATH
BBPATH .= ":${LAYERDIR}"

# We have a packages directory, add to BBFILES
BBFILES += "${LAYERDIR}/recipes-*/*/*.bb \
            ${LAYERDIR}/recipes-*/*/*.bbappend"

BBFILE_COLLECTIONS += "intel-msdk"
BBFILE_PATTERN_intel-msdk := "^${LAYERDIR}/"
BBFILE_PRIORITY_intel-msdk = "10"

# This should only be incremented on significant changes that will
# cause compatibility issues with other layers
LAYERVERSION_intel-msdk = "1"

LICENSE_PATH += "${LAYERDIR}/licenses"

require conf/distro/include/meta_intel_msdk-security_flags.inc
```
